/*
 * this file is ued to change sprd dtsi which can't be changed by overlay
 * such as /delete-node/ /delete-property/ and alises
 */

#include "../lcd/zte_lcd_skyworth_jd9366d_panda_5p45_720p.dtsi"
#include "../lcd/zte_lcd_holitech_st7703_huajiacai_5p45_720p.dtsi"
#include "touchscreen_uranus.dtsi"
&panel_if {
	panel-drivers = <
		&lcd_skyworth_jd9363d_panda_mipi_hd
		&lcd_holitech_st7703_huajiacai_mipi_hd
		&lcd_dummy_mipi_hd
	>;
};

&dispc0 {
	clock-src = <384000000 153600000>;
	clocks = <&clk_twpll_384m>,
		<&clk_twpll_153m6>,
		<&clk_dispc0>,
		<&clk_dispc0_dpi>,
		<&clk_ap_ahb_gates 1>;
};

&sound_vbc_r1p0v3_sprd_codec {
	/delete-property/ sprd,smartamp-boost-names;
	/delete-property/ sprd,smartamp-boost-gpios;
};
